&soc {
	sound {
		/delete-property/ qcom,cdc-us-euro-gpios;
		qcom,msm-micbias1-ext-cap;
		/delete-property/ qcom,msm-micbias2-ext-cap;
		qcom,msm-hs-micbias-type = "external";
		qcom,audio-routing =
			"RX_BIAS", "MCLK",
			"INT_LDO_H", "MCLK",
			"MIC BIAS External", "Handset Mic",
			"MIC BIAS External2", "Headset Mic",
			"MIC BIAS External", "Secondary Mic",
			"AMIC1", "MIC BIAS External",
			"AMIC2", "MIC BIAS External2",
			"AMIC3", "MIC BIAS External";
		qcom,msm-gpios =
			"pri_i2s";
		qcom,pinctrl-names =
			"all_off",
			"pri_i2s_act";
		pinctrl-names =
			"all_off",
			"pri_i2s_act";
		pinctrl-0 = <&cdc_pdm_lines_sus &cdc_pdm_lines_2_sus>;
		pinctrl-1 = <&cdc_pdm_lines_act &cdc_pdm_lines_2_act>;
		/delete-property/ pinctrl-2;
		/delete-property/ pinctrl-3;
		/delete-property/ pinctrl-4;
		/delete-property/ pinctrl-5;
		/delete-property/ pinctrl-6;
		/delete-property/ pinctrl-7;
	};
};
