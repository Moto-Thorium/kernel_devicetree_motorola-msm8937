&int_codec {
	status = "okay";
	qcom,model = "msm8952-snd-card";
	qcom,msm-mbhc-hphl-swh = <1>;
	qcom,msm-mbhc-gnd-swh = <1>;
	qcom,msm-hs-micbias-type = "internal";
	qcom,audio-routing =
		"RX_BIAS", "MCLK",
		"INT_LDO_H", "MCLK",
		"MIC BIAS External", "Handset Mic",
		"MIC BIAS Internal2", "Headset Mic",
		"MIC BIAS External", "Secondary Mic",
		"AMIC1", "MIC BIAS External",
		"AMIC2", "MIC BIAS Internal2",
		"AMIC3", "MIC BIAS External";
	/delete-property/ qcom,hdmi-dba-codec-rx;

	asoc-codec = <&stub_codec>, <&msm_digital_codec>;
	asoc-codec-names = "msm-stub-codec.1", "msm-dig-codec";
};

&soc {
	/delete-node/ sound-9335;
	/delete-node/ wsa881x_analog_vi_pctrl;
	/delete-node/ wsa881x_analog_clk_pctrl;
	/delete-node/ wsa881x_analog_reset_pctrl;

	alsa_to_h2w {
		compatible = "mmi,alsa-to-h2w";
	};
};
